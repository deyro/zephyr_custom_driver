## CMakeLists.txt
```
# Copyright (c) 2024 RD Technologies
# SPDX-License-Identifier: MIT

cmake_minimum_required(VERSION 3.20.0)

# Add our modules directory to Zephyr Modules
list(APPEND ZEPHYR_EXTRA_MODULES ${CMAKE_CURRENT_SOURCE_DIR}/modules)

# Set project, dts and board directories
set(PROJ_ROOT ${CMAKE_CURRENT_SOURCE_DIR}/)
set(DTS_ROOT ${CMAKE_CURRENT_SOURCE_DIR}/dts)
set(BOARD_ROOT ${CMAKE_CURRENT_LIST_DIR})


find_package(Zephyr REQUIRED HINTS $ENV{ZEPHYR_BASE})
project(zephyr_custom_driver)

add_subdirectory(src)
#target_sources(app PRIVATE src/main.c)
```

## sample.yaml
```
sample:
  description: Sample Zephyr project to demonstrate a custom device driver
  name: zephyr custom driver
```

## prj.conf
```kconfig
# Copyright (c) 2024 RD Technologies
# SPDX-License-Identifier: MIT

CONFIG_LOG=y
CONFIG_TEST_RANDOM_GENERATOR=y
```

## boards/native_posix.conf
```kconfig
# Copyright (c) 2024 RD Technologies
# SPDX-License-Identifier: MIT

CONFIG_SENSOR_SIM=y
```

## boards/native_posix.overlay
```dts
/* Copyright (c) 2024 RD Technologies
 * SPDX-License-Identifier: MIT
 */

/ {
	sensor_sim1: sensor_sim1 {
		status = "okay";
		compatible = "rdt,sensor_sim";
		sim-attr = <5>;
	};

	sensor_sim2: sensor_sim2 {
		status = "okay";
		compatible = "rdt,sensor_sim";
		sim-attr = <3>;
	};
};
```

## dts/bindings/sensor/rdt,sensor_sim.yaml
```yaml
# Copyright (c) 2024 RD Technologies
# SPDX-License-Identifier: MIT

description: |
  Sensor simulation driver with dummy data

  Example usage:
  sensor_sim {
    compatible = "rdt,sensor_sim";
    sim-attr = <5>;
  };

compatible: "rdt,sensor_sim"

properties:
  sim-attr:
    type: int
    description: |
      A random integer.
```

## src/main.c
```c
/*
 * Copyright (c) 2024 RD Technologies
 * SPDX-License-Identifier: MIT
 *
 *  Created on: 21-Mar-2024
 *      Author: Rohan Dey (rd@rodeytech.com)
 */

#include <stdio.h>
#include <zephyr/device.h>
#include <zephyr/drivers/sensor.h>

#include <zephyr/logging/log.h>
LOG_MODULE_REGISTER(main);

int main(void)
{
	printf("Custom sensor driver demo on: %s\n", CONFIG_BOARD);

	const struct device* sim_dev1 = DEVICE_DT_GET(DT_NODELABEL(sensor_sim1));
	if (sim_dev1 == NULL) {
		LOG_ERR("device sensor_sim1 not found");
		return -1;
	}

	const struct device* sim_dev2 = DEVICE_DT_GET(DT_NODELABEL(sensor_sim2));
	if (sim_dev2 == NULL) {
		LOG_ERR("device sensor_sim2 not found");
		return -1;
	}

	struct sensor_value val;

	while (1) {
		sensor_sample_fetch_chan(sim_dev1, SENSOR_CHAN_AMBIENT_TEMP);
		sensor_channel_get(sim_dev1, SENSOR_CHAN_AMBIENT_TEMP, &val);
		LOG_INF("sim1 val = %d\n", val.val1);

		sensor_sample_fetch_chan(sim_dev2, SENSOR_CHAN_AMBIENT_TEMP);
		sensor_channel_get(sim_dev2, SENSOR_CHAN_AMBIENT_TEMP, &val);
		LOG_INF("sim2 val = %d\n", val.val1);

		k_sleep(K_MSEC(1000));
	}

	return 0;
}
```
